## components/lcd/Kconfig.projbuild
```kconfig
menu "LCD Configuration"

choice LCD_TYPE
	prompt "LCD module type"
	default LCD_TYPE_ST7789V
	help
		The type of LCD on the evaluation board.

config LCD_TYPE_ST7789V
	bool "ST7789V"
config LCD_TYPE_ILI9341
	bool "ILI9341"
endchoice

endmenu
```

## main/Kconfig.projbuild
```kconfig
menu "K2 robot Configuration"

config WIFI_MODE_STA
	bool "set default to sta mode"
	default y
	help
		Enable this option if you want to set wifi the sta mode.

config WIFI_STA_SSID
    string "WiFi SSID @ STA MODE"
    default ""
    help
        SSID (network name) for the demo to connect to.

config WIFI_STA_PASSWORD
    string "WiFi Password @ STA MODE"
    default ""
    help
        Password for your network.

config WIFI_AP_SSID
    string "WiFi SSID @ AP MODE"
    default "K2Virgo"
    help
        SSID (network name) for the demo to connect to.

config WIFI_AP_PASSWORD
    string "WiFi Password @ AP MODE"
    default "88888888"
    help
        Password for your network.

config WIFI_MAX_STA_CONN
	int "when the wifi is AP mode, limit the client number"
	default 1
	help
		Enable this option if you want to set wifi the sta mode.

menu "OTA Configuration"
config OTA_FIRMWARE_UPG_URL
        string "Firmware Upgrade URL"
        default "https://192.168.1.221:8070/hello-world.bin"
        help
            URL of server which hosts the firmware image.

    config OTA_GPIO_DIAGNOSTIC
        int "Number of the GPIO input for diagnostic"
        range 0 39
        default 4
        help
            Used to demonstrate how a rollback works.
            The selected GPIO will be configured as an input with internal pull-up enabled.
            To trigger a rollback, this GPIO must be pulled low while the message
            `Diagnostics (5 sec)...` which will be on first boot.
            If GPIO is not pulled low then the operable of the app will be confirmed.
endmenu

config QR_RECOGNIZE
	bool "QR recognize Support"
	default y
	help
		Enable this option if you want to recognize qr.
endmenu
```
